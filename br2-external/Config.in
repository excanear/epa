## br2-external/package/epa/Config.in
```kconfig
config BR2_PACKAGE_EPA
	bool "epa"
	default y
	help
	  EPA (Excanear Portable Appliance) core init/shell/modules binary.
	  Runs as PID 1 on the target - there is no other init system.
```
